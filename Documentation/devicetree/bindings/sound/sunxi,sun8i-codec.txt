## Documentation/devicetree/bindings/sound/sunxi,sun8i-codec.txt
```
* Allwinner A23/A33 Codec

Required properties:
- compatible: must be either "allwinner,sun4i-a23-codec" or
  "allwinner,sun7i-a33-codec"
- reg: must contain the registers location and length for the base and
  the prcm
- interrupts: must contain the codec interrupt
- clocks: a list of phandle + clock-specifer pairs, one for each entry
  in clock-names.
- clock-names: should contain followings:
   - "apb": the parent APB clock for this controller
   - "codec": the parent module clock

Example:
codec: codec@01c22c00 {
	#sound-dai-cells = <0>;
	compatible = "allwinner,sun8i-a33-codec";
	reg = <0x01c22e00 0x400>,	/* SUNXI_AUDIO_PBASE + 0x200 */
	      <0x01f015c0 0x4>;	/* SUNXI_R_PRCM_PBASE + 0x1c0 */
	reg-names = "audio", "prcm";
	interrupts = <GIC_SPI 29 IRQ_TYPE_LEVEL_HIGH>;
	clocks = <&ccu CLK_BUS_CODEC>, <&ccu CLK_AC_DIG>;
	clock-names = "apb", "codec";
};
```

## sound/soc/sunxi/Kconfig
```kconfig
menu "Allwinner SoC Audio support"

config SND_SUN4I_CODEC
	tristate "Allwinner A10 Codec Support"
	select SND_SOC_GENERIC_DMAENGINE_PCM
	select REGMAP_MMIO
	help
	  Select Y or M to add support for the Codec embedded in the Allwinner
	  A10 and affiliated SoCs.

config SND_SUN4I_I2S
	tristate "Allwinner A10 I2S Support"
	select SND_SOC_GENERIC_DMAENGINE_PCM
	select REGMAP_MMIO
	help
	  Say Y or M if you want to add support for codecs attached to
	  the Allwinner A10 I2S. You will also need to select the
	  individual machine drivers to support below.

config SND_SUN4I_SPDIF
	tristate "Allwinner A10 SPDIF Support"
	depends on OF
	select SND_SOC_GENERIC_DMAENGINE_PCM
	select REGMAP_MMIO
	help
	  Say Y or M to add support for the S/PDIF audio block in the Allwinner
	  A10 and affiliated SoCs.

config SND_SUN8I
	tristate "Audio machine for SUN8I & SUN6I chips"
	select SND_SUN8I_CODEC
	select SND_SUN4I_I2S
	default n
	help
	  Say Y or M if you want to add sun8i/6i machine support

config SND_SUN8I_CODEC
	tristate "Audiocodec for the SUN8I chips"
	default n
        help
	  Say Y or M if you want to add sun8i audiocodec support

endmenu
```
